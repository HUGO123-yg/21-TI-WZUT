/*********************************************************************************************************************
* CYT4BB Opensourec Library 即（ CYT4BB 开源库）是一个基于官方 SDK 接口的第三方开源库
* Copyright (c) 2022 SEEKFREE 逐飞科技
*
* 本文件是 CYT4BB 开源库的一部分
*
* CYT4BB 开源库 是免费软件
* 您可以根据自由软件基金会发布的 GPL（GNU General Public License，即 GNU通用公共许可证）的条款
* 即 GPL 的第3版（即 GPL3.0）或（您选择的）任何后来的版本，重新发布和/或修改它
*
* 本开源库的发布是希望它能发挥作用，但并未对其作任何的保证
* 甚至没有隐含的适销性或适合特定用途的保证
* 更多细节请参见 GPL
*
* 您应该在收到本开源库的同时收到一份 GPL 的副本
* 如果没有，请参阅<https://www.gnu.org/licenses/>
*
* 额外注明：
* 本开源库使用 GPL3.0 开源许可证协议 以上许可申明为译文版本
* 许可申明英文版在 libraries/doc 文件夹下的 GPL3_permission_statement.txt 文件中
* 许可证副本在 libraries 文件夹下 即该文件夹下的 LICENSE 文件
* 欢迎各位使用并传播本程序 但修改内容时必须保留逐飞科技的版权声明（即本声明）
*
* 文件名称          main_cm7_0
* 公司名称          成都逐飞科技有限公司
* 版本信息          查看 libraries/doc 文件夹内 version 文件 版本说明
* 开发环境          IAR 9.40.1
* 适用平台          CYT4BB
* 店铺链接          https://seekfree.taobao.com/
*
* 修改记录
* 日期              作者                备注
* 2024-1-4       pudding            first version
********************************************************************************************************************/

#include "zf_common_headfile.h"
// 打开新的工程或者工程移动了位置务必执行以下操作
// 第一步 关闭上面所有打开的文件
// 第二步 project->clean  等待下方进度条走完

// *************************** 例程硬件连接说明 ***************************
//      使用 sbus接收机 模块连接
//      模块管脚                                 单片机管脚
//      SBUS-TX             查看 zf_device_uart_receiver.h 文件中 UART_RECEVIER_RX_PIN 宏定义的引脚
//      SBUS-GND            核心板电源地 GND（需要与外部电源共地）
//      SBUS-5V             外接5V电源
//      SBUS-SBUS           悬空
//      SBUS-BAT+           电源正极 (3V3)
//      SBUS-BAT-           电源负极 (GND)

// *************************** 例程测试说明 ***************************
// 1.核心板烧录完成本例程，需要在断电情况下将调试下载器和SBUS接收机与单片机连接
//
// 2.将调试下载器连接电脑，为SBUS接收机提供5V电源完成上电(注意外部电源于核心板需要共地！！！)
//
// 3.将SBUS接收机与遥控器配对，先将长按SBUS接收机按键，等到绿灯连续闪烁，打开遥控器电源，等到接收机绿灯常亮，完成配对。（详见sbus接收机说明书）
//
// 4.电脑上使用 逐飞助手 打开对应的串口，串口波特率为 DEBUG_UART_BAUDRATE 宏定义 默认 115200，核心板按下复位按键
//
// 5.可以在 逐飞助手 上看到如下串口信息：
//                  CH1-CH6 data: ... ...
// 6.同时在遥控器上可以看见接收电压为3.3v左右，并且可以通过遥控器各个通道按键或旋钮更改通道数据， 逐飞助手 上可以看见对应的数据变化。
//
// 7.在正常输出串口数据后，将遥控器关闭可以看到如下串口信息：
//                  Remote control has been disconnected.
//
// 如果发现现象与说明严重不符 请参照本文件最下方 例程常见问题说明 进行排查

// **************************** 代码区域 ***************************
int main(void)
{
    clock_init(SYSTEM_CLOCK_250M); 	// 时钟配置及系统初始化<务必保留>
    debug_init();                          // 调试串口信息初始化
    
    // 此处编写用户代码 例如外设初始化代码等

uart_receiver_init();                                            //sbus接收机初始化

    // 此处编写用户代码 例如外设初始化代码等
    while(true)
    {
        // 此处编写需要循环执行的代码

      
        if(1 == uart_receiver.finsh_flag)                            // 帧完成标志判断
        {
            if(1 == uart_receiver.state)                             // 遥控器失控状态判断
            {
                printf("CH1-CH6 data: ");
                for(int i = 0; i < 6; i++)
                {
                    printf("%d ", uart_receiver.channel[i]);         // 串口输出6个通道数据
                }
                printf("\r\n");
            }
            else
            {
                printf("Remote control has been disconnected.\r\n"); // 串口输出失控提示
            }
            uart_receiver.finsh_flag = 0;                            // 帧完成标志复位
        }  
      
      
        // 此处编写需要循环执行的代码
    }
}

// **************************** 代码区域 ****************************

// *************************** 例程常见问题说明 ***************************
// 遇到问题时请按照以下问题检查列表检查
//
// 问题1：串口没有数据
//      查看 逐飞助手 打开的是否是正确的串口，检查打开的 COM 口是否对应的是调试下载器
//      那么检查下载器线是否松动，检查核心板串口跳线是否已经焊接，串口跳线查看核心板原理图即可找到
//
// 问题2：串口数据乱码
//      查看 逐飞助手 设置的波特率是否与程序设置一致，程序中 zf_common_debug.h 文件中 DEBUG_UART_BAUDRATE 宏定义为 debug uart 使用的串口波特率
//
// 问题3：数据不连续发送，会有卡顿
//      查看接收机灯是否常亮，若接收机灯不规律闪，说明没有对接收机进行5v供电，信号微弱，需要为其提供稳定的5V电源
//
// 问题4：遥控器无法控制数据改变，或者没有数据
//      查看接收机灯是否常亮，若接收机灯不常亮，说明没有对接收机与遥控器没有配对，配对详见sbus接收机说明书
